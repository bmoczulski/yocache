## meta-yocache/conf/layer.conf
```bitbake
# yocache build-side integration layer.
#
# Classes-only for now (classes/yocache.bbclass). No recipes; the BBFILES
# globs are kept standard so dropping a recipe in later just works.

BBPATH .= ":${LAYERDIR}"
BBFILES += "${LAYERDIR}/recipes-*/*/*.bb ${LAYERDIR}/recipes-*/*/*.bbappend"

# lib/yocache/ must be importable (the uploader lives there so its thread handle
# persists in sys.modules across BuildStarted/BuildCompleted calls). addpylib is
# only honoured with baseconfig=True, which bitbake only sets for files it parses
# directly (layer.conf / bblayers.conf) — never for included .inc files. The
# bbclass therefore sets sys.path itself at import time using this variable.
YOCACHE_LAYER_LIBDIR = "${LAYERDIR}/lib"

BBFILE_COLLECTIONS += "yocache"
BBFILE_PATTERN_yocache = "^${LAYERDIR}/"
BBFILE_PRIORITY_yocache = "6"

LAYERVERSION_yocache = "1"
LAYERDEPENDS_yocache = "core"
# Must intersect oe-core's LAYERSERIES_CORENAMES, else bitbake rejects the layer
# as incompatible. wrynose = the poky 6.0 this layer was authored against;
# also build-tested against dunfell (bb 1.46) and kirkstone. The releases
# between dunfell and wrynose aren't individually build-tested, but the only
# release-sensitive code path (the _prepend/:prepend override-syntax split,
# below) buckets every one of them alongside an already-tested release, so
# they're declared compatible too.
LAYERSERIES_COMPAT_yocache = "dunfell gatesgarth hardknott honister kirkstone langdale mickledore nanbield scarthgap styhead walnascar wrynose"
```
